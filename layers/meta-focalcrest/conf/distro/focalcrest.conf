## layers/meta-focalcrest/conf/distro/focalcrest.conf
```bitbake
# SPDX-License-Identifier: MIT
# Copyright (c) 2026 Focalcrest

DISTRO = "focalcrest"
DISTRO_NAME = "az0x (Focalcrest AZ0x base distribution)"
DISTRO_VERSION = "6.0"
DISTRO_CODENAME = "wrynose"
SDK_VENDOR = "-fcsdk"
SDK_VERSION = "${DISTRO_VERSION}"
MAINTAINER = "Focalcrest <support@focalcrest.com>"

INIT_MANAGER = "systemd"

DISTRO_FEATURES_OPTED_OUT = " \
    x11 wayland vulkan pulseaudio 3g nfc nfs zeroconf ptest debuginfod \
"

PACKAGE_CLASSES ?= "package_ipk"

LICENSE_CREATE_PACKAGE ?= "1"

require conf/distro/include/focalcrest-versions.inc

BUILD_REPRODUCIBLE_BINARIES ?= "1"

SANITY_TESTED_DISTROS ?= " \
    ubuntu-22.04 \n \
    ubuntu-24.04 \n \
"
```

## layers/meta-focalcrest/conf/distro/include/focalcrest-versions.inc
```bitbake
# SPDX-License-Identifier: MIT
# Copyright (c) 2026 Focalcrest

PREFERRED_PROVIDER_virtual/kernel ?= "linux-yocto"
PREFERRED_VERSION_linux-yocto ?= "6.18%"

PREFERRED_PROVIDER_virtual/bootloader ?= "u-boot"

PREFERRED_VERSION_u-boot = "2026.07"
PREFERRED_VERSION_u-boot-tools = "2026.07"
```

## layers/meta-focalcrest/conf/layer.conf
```bitbake
# SPDX-License-Identifier: MIT
# Copyright (c) 2026 Focalcrest

BBPATH .= ":${LAYERDIR}"

BBFILES += "${LAYERDIR}/recipes-*/*/*.bb \
            ${LAYERDIR}/recipes-*/*/*.bbappend"

BBFILE_COLLECTIONS += "focalcrest"
BBFILE_PATTERN_focalcrest = "^${LAYERDIR}/"
BBFILE_PRIORITY_focalcrest = "20"

LAYERVERSION_focalcrest = "1"
LAYERDEPENDS_focalcrest = "core rockchip meta-arm openembedded-layer networking-layer"
LAYERSERIES_COMPAT_focalcrest = "wrynose"
```

## layers/meta-focalcrest/conf/machine/include/focalcrest-common.inc
```bitbake
# SPDX-License-Identifier: MIT
# Copyright (c) 2026 Focalcrest

MACHINEOVERRIDES =. "focalcrest:"

IMAGE_FSTYPES:append = " ext4 tar.zst"

WKS_FILE = "focalcrest-emmc.wks.in"
FC_BOOT_SIZE          ?= "128M"
FC_ROOTFS_EXTRA_SPACE ?= "256"
WICVARS:append = " FC_BOOT_SIZE FC_ROOTFS_EXTRA_SPACE"

MACHINE_FEATURES:append = " usbhost usbgadget rtc vfat"
MACHINE_EXTRA_RRECOMMENDS += "kernel-modules"

# Boot through a custom FIT bootcmd instead of extlinux
UBOOT_EXTLINUX = "0"
MACHINE_ESSENTIAL_EXTRA_RDEPENDS:remove = "u-boot-extlinux"
IMAGE_BOOT_FILES = "fitImage;kernel.fit"

UBOOT_SIGN_ENABLE ?= "0"
FIT_GENERATE_KEYS ?= "0"
```

## layers/meta-focalcrest/conf/machine/include/focalcrest-rk3576.inc
```bitbake
# SPDX-License-Identifier: MIT
# Copyright (c) 2026 Focalcrest

SOC_FAMILY = "rk3576"

DEFAULTTUNE ?= "cortexa72-cortexa53"

ROCKCHIP_CLOSED_TPL ?= "1"

require conf/machine/include/soc-family.inc
require conf/machine/include/rockchip-defaults.inc
require conf/machine/include/arm/armv8a/tune-cortexa72-cortexa53.inc
require conf/machine/include/rockchip-wic.inc
require conf/machine/include/focalcrest-common.inc

MACHINEOVERRIDES =. "focalcrest-rk3576:"

PREFERRED_PROVIDER_trusted-firmware-a = "rockchip-rkbin-tf-a"
PREFERRED_PROVIDER_optee-os = "rockchip-rkbin-optee-os"

UBOOT_SUFFIX ?= "itb"

SERIAL_CONSOLES ?= "1500000;ttyS0"

KBUILD_DEFCONFIG = ""

UBOOT_ENTRYPOINT   = "0x42000000"
UBOOT_LOADADDRESS  = "0x42000000"
FC_OPTEE_LOAD_ADDR = "0x48400000"
```

## layers/meta-focalcrest/conf/machine/rk3566-autonomic-m1.conf
```bitbake
# SPDX-License-Identifier: MIT
# Copyright (c) 2026 Focalcrest

require conf/machine/include/focalcrest-rk3566.inc

MACHINEOVERRIDES =. "autonomic-m1:"

KERNEL_DEVICETREE = "rockchip/rk3566-autonomic-m1.dtb"

UBOOT_MACHINE = "rk3566-autonomic-m1_defconfig"

MACHINE_FEATURES:append = " wifi bluetooth"

MACHINE_EXTRA_RRECOMMENDS += "firmware-ap6256"
```

## layers/meta-focalcrest/conf/machine/rk3566-focalcrest-az07.conf
```bitbake
# SPDX-License-Identifier: MIT
# Copyright (c) 2026 Focalcrest

require conf/machine/include/focalcrest-rk3566.inc

MACHINEOVERRIDES =. "az07:"

KERNEL_DEVICETREE = "rockchip/rk3566-focalcrest-az07.dtb"

KBUILD_DEFCONFIG = ""

UBOOT_MACHINE = "rk3566-focalcrest-az07_defconfig"

UBOOT_EXTLINUX = "0"
MACHINE_ESSENTIAL_EXTRA_RDEPENDS:remove = "u-boot-extlinux"

UBOOT_ENTRYPOINT  = "0x02000000"
UBOOT_LOADADDRESS = "0x02000000"

IMAGE_BOOT_FILES = "fitImage;kernel.fit"

MACHINE_FEATURES:append = " wifi bluetooth"

MACHINE_EXTRA_RRECOMMENDS += "firmware-ap6256"
```

## layers/meta-focalcrest/conf/machine/rk3576s-focalcrest-az08.conf
```bitbake
# SPDX-License-Identifier: MIT
# Copyright (c) 2026 Focalcrest

require conf/machine/include/focalcrest-rk3576.inc

MACHINEOVERRIDES =. "az08:"

KERNEL_DEVICETREE = "rockchip/rk3576s-focalcrest-az08.dtb"

UBOOT_MACHINE = "rk3576s-focalcrest-az08_defconfig"

MACHINE_FEATURES:append = " wifi bluetooth"

MACHINE_EXTRA_RRECOMMENDS += "firmware-ap6256"
```

## layers/meta-focalcrest/conf/machine/rk3588s-focalcrest-az04b.conf
```bitbake
# SPDX-License-Identifier: MIT
# Copyright (c) 2026 Focalcrest

require conf/machine/include/focalcrest-rk3588s.inc

MACHINEOVERRIDES =. "az04b:"

KERNEL_DEVICETREE = "rockchip/rk3588s-focalcrest-az04b.dtb"

UBOOT_MACHINE = "rk3588s-focalcrest-az04b_defconfig"

MACHINE_FEATURES:append = " wifi bluetooth"

MACHINE_EXTRA_RRECOMMENDS += "firmware-ap6256 linux-firmware-mali-csffw-arch108"
```

## layers/meta-focalcrest/recipes-bsp/u-boot/files/rk3566-autonomic-m1_defconfig
```kconfig
CONFIG_ARM=y
CONFIG_SKIP_LOWLEVEL_INIT=y
CONFIG_COUNTER_FREQUENCY=24000000
CONFIG_ARCH_ROCKCHIP=y
CONFIG_ROCKCHIP_RK3568=y
CONFIG_SYS_LOAD_ADDR=0xc00800

CONFIG_DEFAULT_DEVICE_TREE="rk3566-autonomic-m1"
CONFIG_DEFAULT_FDT_FILE="rockchip/rk3566-autonomic-m1.dtb"
# CONFIG_OF_UPSTREAM is not set
CONFIG_OF_LIVE=y
CONFIG_SPL_OF_CONTROL=y
CONFIG_OF_SPL_REMOVE_PROPS="clock-names interrupt-parent assigned-clocks assigned-clock-rates assigned-clock-parents"

CONFIG_DEBUG_UART=y
CONFIG_DEBUG_UART_BASE=0xFE660000
CONFIG_DEBUG_UART_CLOCK=24000000
CONFIG_DEBUG_UART_SHIFT=2
CONFIG_SYS_NS16550_MEM32=y
CONFIG_BAUDRATE=1500000
CONFIG_SPL_SERIAL=y
# CONFIG_DISPLAY_CPUINFO is not set

CONFIG_SPL_MAX_SIZE=0x40000
CONFIG_SPL_ATF=y
CONFIG_FIT=y
CONFIG_FIT_VERBOSE=y
CONFIG_SPL_LOAD_FIT=y
CONFIG_LEGACY_IMAGE_FORMAT=y
# CONFIG_SPL_RAW_IMAGE_SUPPORT is not set
# CONFIG_FIT_SIGNATURE is not set
# CONFIG_SPL_FIT_SIGNATURE is not set

CONFIG_MMC=y
CONFIG_MMC_SDHCI=y
CONFIG_MMC_SDHCI_SDMA=y
CONFIG_MMC_SDHCI_ROCKCHIP=y
CONFIG_SUPPORT_EMMC_RPMB=y
CONFIG_CMD_MMC=y
# CONFIG_MMC_DW is not set
# CONFIG_MMC_DW_ROCKCHIP is not set
# CONFIG_SPL_SPI is not set
# CONFIG_SPL_SPI_LOAD is not set
# CONFIG_SPL_SPI_FLASH_SUPPORT is not set
# CONFIG_ROCKCHIP_SFC is not set
# CONFIG_ROCKCHIP_SPI_IMAGE is not set
CONFIG_NO_NET=y
# CONFIG_PCI is not set
# CONFIG_AHCI is not set
# CONFIG_SCSI is not set

CONFIG_EFI_PARTITION=y
CONFIG_PARTITION_UUIDS=y
CONFIG_CMD_PART=y
CONFIG_CMD_GPT=y
CONFIG_FS_EXT4=y
CONFIG_CMD_EXT4=y
CONFIG_CMD_FS_GENERIC=y
# CONFIG_SPL_DOS_PARTITION is not set

CONFIG_MISC=y
CONFIG_ROCKCHIP_IODOMAIN=y
CONFIG_DM_PMIC=y
CONFIG_PMIC_RK8XX=y
CONFIG_DM_REGULATOR=y
CONFIG_DM_REGULATOR_FIXED=y
CONFIG_REGULATOR_RK8XX=y
CONFIG_SYS_I2C_ROCKCHIP=y
CONFIG_CMD_I2C=y
CONFIG_CMD_PMIC=y
CONFIG_CMD_REGULATOR=y

CONFIG_SPL_CLK=y
CONFIG_SPL_DM_SEQ_ALIAS=y
CONFIG_SPL_REGMAP=y
CONFIG_SPL_SYSCON=y
CONFIG_SPL_PINCTRL=y
CONFIG_SPL_RAM=y
CONFIG_ROCKCHIP_GPIO=y
CONFIG_CMD_GPIO=y
CONFIG_SYSRESET=y
CONFIG_SYSRESET_PSCI=y
CONFIG_ERRNO_STR=y
CONFIG_CMD_MEMINFO=y
CONFIG_CMD_RNG=y
# CONFIG_CMD_SETEXPR is not set

CONFIG_USB=y
CONFIG_USB_DWC3=y
CONFIG_USB_DWC3_GENERIC=y
CONFIG_PHY_ROCKCHIP_INNO_USB2=y
CONFIG_USB_GADGET=y
CONFIG_USB_GADGET_DOWNLOAD=y
CONFIG_USB_FUNCTION_ROCKUSB=y
CONFIG_CMD_ROCKUSB=y
CONFIG_CMD_USB_MASS_STORAGE=y
# CONFIG_USB_FUNCTION_FASTBOOT is not set

CONFIG_ENV_USE_DEFAULT_ENV_TEXT_FILE=y
CONFIG_ENV_DEFAULT_ENV_TEXT_FILE="board/autonomic/m1/rk3566-autonomic-m1.env"
# CONFIG_BOOTSTD_DEFAULTS is not set
# CONFIG_BOOTMETH_VBE is not set
CONFIG_ENV_IS_NOWHERE=y
```
